## drivers/Kconfig
```kconfig
# SPDX-License-Identifier: Apache-2.0

menu "Regulator drivers"
rsource "regulator/Kconfig"
endmenu
```

## drivers/regulator/Kconfig
```kconfig
# SPDX-License-Identifier: Apache-2.0

if REGULATOR
rsource "scr_power_controller_generic/Kconfig"
endif # REGULATOR
```

## drivers/regulator/scr_power_controller_generic/Kconfig
```kconfig
# SPDX-License-Identifier: Apache-2.0

config SCR_POWER_CONTROLLER_GENERIC
	bool "SCR power controller"
	default y
	depends on DT_HAS_SCR_POWER_CONTROLLER_GENERIC_ENABLED
	select GPIO
	help
	  Enable driver for generic SCR power controller
```

## dts/bindings/regulator/scr-power-controller-generic.yaml
```yaml
# Copyright (c) 2023 Libre Solar Technologies GmbH
# SPDX-License-Identifier: Apache-2.0

description: Generic SCR power controller with zero crossing detection

include:
  - name: base.yaml
  - name: regulator.yaml
    property-allowlist:
      - regulator-name
      - regulator-boot-on
      - regulator-always-on
      - regulator-min-microvolt
      - regulator-max-microvolt
      - startup-delay-us
      - off-on-delay-us

compatible: "scr-power-controller-generic"

properties:
  regulator-name:
    required: true

  enable-gpios:
    type: phandle-array
    required: true
    description: |
      The GPIO connected to the enable/disable input of the power controller.

  zero-crossing-gpios:
    type: phandle-array
    required: true
    description: |
      The GPIO connected to the zero crossing detection output of the power controller.

  
```
